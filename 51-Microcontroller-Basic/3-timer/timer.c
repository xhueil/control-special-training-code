/*
 *****************************************************************************************
 *	实 验 名 称:定时器中断的应用
 *  实 验 平 台：清翔电子 QX-MCS51开发板
 *	创 建 作 者：miki
 *  功 能 说 明：使用定时器0的方式1测试定时器定时器1s让数码管自加1来实现秒表
 *  github 地 址：
 *	创 建 日 期：2017-11-15
 *****************************************************************************************
 */
/************************************* 包含头文件 ***************************************/
#include <reg52.h>

/**************************************** 宏定义 *****************************************/
#define uint unsigned int 
#define uchar unsigned char

//typedef unsigned char uchar;
//typedef unsigned int uint;

/*************************************** IO口定义 ****************************************/

sbit LED = P1 ^ 0;
sbit DULA_IO = P2^6;
sbit WELA_IO = P2^7;

/************************************* 全局变量定义 **************************************/
uchar GlobalCount = 0;
uchar GlobalNum	= 0;

uchar code GlobalDisplayTable[] = 
	{0x3f,0x06,0x5b,0x4f,0x66,
	 0x6d,0x7d,0x07,0x7f,0x6f};	/* 段选，选择要显示的数字0-9 */


/*************************************** 函数声明 ****************************************/
static void timerInterruptInit(void);
static void digitalTubeDisplay(uchar num);
static void delayMs(uint xms);

/*
 *****************************************************************************************
 * 函数名称：main
 * 函数功能：主函数，整个程序入口
 * 输入参数：无
 * 输出参数：无
 * 其他说明：无
 ******************************************************************************************
 */
void main(void)
{	
    timerInterruptInit();	//定时器中断初始化
    while(1)
    {
  		digitalTubeDisplay(GlobalNum);
    }
}

/*
 *****************************************************************************************
 * 函数名称：timerInterruptInit
 * 函数功能：定时器和中断初始化
 * 输入参数：无
 * 输出参数：无
 * 其他说明：无
 ******************************************************************************************
 */
void timerInterruptInit(void)
{
	TMOD = 0x01; //初始化TMOD,定时器0,方式1
	TH0 = (65536 - 50000) / 256; //装填计数
	TL0 = (65536 - 50000) % 256;
	EA = 1; //开放所有中断
	ET0 = 1; //开放定时器0中断控制位
	TR0 = 1; //定时器0开始计时
}

/*
 *****************************************************************************************
 * 函数名称：digitalTubeDisplay
 * 函数功能：数码管显示函数
 * 输入参数：num：需要显示的数字
 * 输出参数：无
 * 其他说明：无
 ******************************************************************************************
 */
void digitalTubeDisplay(uchar num)
{
    uchar ge,shi;
   	
	ge = num % 10;
	shi = num / 10;

	/*************** 显示个位 ****************/
	DULA_IO = 1;
   	P0 = GlobalDisplayTable[ge];
   	DULA_IO = 0;

   	P0 = 0xff;

   	WELA_IO = 1;
   	P0 = 0x7f;
   	WELA_IO = 0;

	delayMs(5);

	/*************** 显示十位 ****************/
	DULA_IO = 1;
   	P0 = GlobalDisplayTable[shi];
   	DULA_IO = 0;

   	P0 = 0xff;

   	WELA_IO = 1;
   	P0 = 0xbf;
   	WELA_IO = 0;
	delayMs(5);
}

/*
 *****************************************************************************************
 * 函数名称：delayMs
 * 函数功能：实现毫秒级的延时
 * 输入参数：xms：需要延时时间
 * 输出参数：无
 * 其他说明：无
 ******************************************************************************************
 */
void delayMs(uint xms)
{
    uint x,y;
    for (x=xms;x>0;x--)
        for (y=114;y>0;y--);
}

/*
 *****************************************************************************************
 * 函数名称：Timer0InterruptHandler
 * 函数功能：定时器0中断服务函数
 * 输入参数：无
 * 输出参数：无
 * 其他说明：无
 ******************************************************************************************
 */
void Timer0InterruptHandler() interrupt 1
{
   TH0 = (65536 - 50000) / 256; //触发中断时重新装填计时
   TL0 = (65536 - 50000) % 256;

   GlobalCount ++;
   if (GlobalCount >= 20)
   {
       GlobalCount = 0;

	   GlobalNum ++;
	   if (GlobalNum >= 60)
	   {
	       GlobalNum = 0;
	   }
   }
}

